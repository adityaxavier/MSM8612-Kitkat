/* Copyright (c) 2013, The Linux Foundation. All rights reserved.
 *
 * This program is free software; you can redistribute it and/or modify
 * it under the terms of the GNU General Public License version 2 and
 * only version 2 as published by the Free Software Foundation.
 *
 * This program is distributed in the hope that it will be useful,
 * but WITHOUT ANY WARRANTY; without even the implied warranty of
 * MERCHANTABILITY or FITNESS FOR A PARTICULAR PURPOSE.  See the
 * GNU General Public License for more details.
 */

/*---------------------------------------------------------------------------
 * This file is autogenerated file using gcdb parser. Please do not edit it.
 * Update input XML file to add a new entry or update variable in this file
 * VERSION = "1.0"
 *---------------------------------------------------------------------------*/
&mdss_mdp {
	dsi_ili9806c_wvga_vid: qcom,mdss_dsi_ili9806c_wvga_video {
		qcom,mdss-dsi-panel-name = "ILI9806C WVGA video mode dsi panel";
		qcom,mdss-dsi-panel-controller = <&mdss_dsi0>;
		qcom,mdss-dsi-panel-type = "dsi_video_mode";
		qcom,mdss-dsi-panel-destination = "display_1";
		qcom,mdss-dsi-panel-framerate = <55>;
		qcom,mdss-dsi-virtual-channel-id = <0>;
		qcom,mdss-dsi-stream = <0>;
		qcom,mdss-dsi-panel-width = <480>;
		qcom,mdss-dsi-panel-height = <800>;
		qcom,mdss-dsi-h-front-porch = <100>;
		qcom,mdss-dsi-h-back-porch = <100>;
		qcom,mdss-dsi-h-pulse-width = <8>;
		qcom,mdss-dsi-h-sync-skew = <0>;
		qcom,mdss-dsi-v-back-porch = <16>;
		qcom,mdss-dsi-v-front-porch = <12>;
		qcom,mdss-dsi-v-pulse-width = <2>;
		qcom,mdss-dsi-h-left-border = <0>;
		qcom,mdss-dsi-h-right-border = <0>;
		qcom,mdss-dsi-v-top-border = <0>;
		qcom,mdss-dsi-v-bottom-border = <0>;
		qcom,mdss-dsi-bpp = <24>;
		qcom,mdss-dsi-color-order = <0>;
		qcom,mdss-dsi-underflow-color = <0xff>;
		qcom,mdss-dsi-border-color = <0>;
		qcom,mdss-dsi-on-command = [				
					29 01 00 00 0A 00 04 FF FF 98 16  
					29 01 00 00 00 00 02 BA 60
					29 01 00 00 00 00 02 B0 01
					29 01 00 00 00 00 18 BC 03 0D 61 FF 01 01 1B 0F 3A 63 FF FF 01 01 02 00 D5 D0 01 00 00 43 0B 
					29 01 00 00 00 00 09 BD 01 23 45 67 01 23 45 67
					29 01 00 00 00 00 12 BE 13 22 DD CC BB AA 22 26 72 FF 22 EE 22 22 22 22 22
					29 01 00 00 00 00 03 ED 7F 0F
					29 01 00 00 00 00 02 F3 70  
					29 01 00 00 00 00 02 B4 02  
					29 01 00 00 00 00 04 C0 0F 0B 08
					29 01 00 00 00 00 05 C1 17 90 78 20
					29 01 00 00 00 00 02 D8 50  
					29 01 00 00 00 00 02 FC 08  
					29 01 00 00 00 00 11 E0 00 06 13 14 14 1F CA 07 02 0C 02 10 0F 33 2E 00
					29 01 00 00 00 00 11 E1 00 04 0E 0F 13 17 7A 09 04 07 07 0B 0C 26 21 00
					29 01 00 00 00 00 09 D5 06 0A 0C 0C CB A5 01 04
					29 01 00 00 00 00 02 F7 8A
					29 01 00 00 00 00 02 C7 6E 
					29 01 00 00 00 00 05 F9 04 FF 80 90
					05 01 00 00 78 00 02 11 00
					05 01 00 00 32 00 02 29 00
					];
		qcom,mdss-dsi-off-command = [05 01 00 00 32 00 02 28 00
					05 01 00 00 78 00 02 10 00];
		qcom,mdss-dsi-on-command-state = "dsi_lp_mode";
		qcom,mdss-dsi-off-command-state = "dsi_lp_mode";
		qcom,mdss-dsi-h-sync-pulse = <1>;
		qcom,mdss-dsi-traffic-mode = <2>;
		qcom,mdss-dsi-lane-map = <1>;
		qcom,mdss-dsi-bllp-eof-power-mode;
		qcom,mdss-dsi-bllp-power-mode;
		qcom,mdss-dsi-lane-0-state;
		qcom,mdss-dsi-lane-1-state;
		qcom,mdss-dsi-panel-timings = [8B 1F 14 00 45 4A 19 23 23 03 04 00];
		qcom,mdss-dsi-t-clk-post = <0x04>;
		qcom,mdss-dsi-t-clk-pre = <0x1b>;
		qcom,mdss-dsi-bl-min-level = <20>;
		qcom,mdss-dsi-bl-max-level = <255>;
		qcom,mdss-dsi-dma-trigger = <4>;
		qcom,mdss-dsi-mdp-trigger = <0>;
		qcom,mdss-dsi-bl-pmic-control-type = "bl_ctrl_wled";
		qcom,mdss-dsi-reset-sequence = <1 20>, <0 20>, <1 20>;

	};
};
