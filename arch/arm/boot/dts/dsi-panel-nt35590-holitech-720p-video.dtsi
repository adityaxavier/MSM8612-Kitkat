/* Copyright (c) 2013, The Linux Foundation. All rights reserved.
 *
 * This program is free software; you can redistribute it and/or modify
 * it under the terms of the GNU General Public License version 2 and
 * only version 2 as published by the Free Software Foundation.
 *
 * This program is distributed in the hope that it will be useful,
 * but WITHOUT ANY WARRANTY; without even the implied warranty of
 * MERCHANTABILITY or FITNESS FOR A PARTICULAR PURPOSE.  See the
 * GNU General Public License for more details.
 */

/*---------------------------------------------------------------------------
 * This file is autogenerated file using gcdb parser. Please do not edit it.
 * Update input XML file to add a new entry or update variable in this file
 * VERSION = "1.0"
 *---------------------------------------------------------------------------*/
&mdss_mdp {
	dsi_nt35590_holitech_720_vid: qcom,mdss_dsi_nt35590_720p_video {
		qcom,mdss-dsi-panel-name = "nt35590 720p video mode dsi panel";
		qcom,mdss-dsi-panel-controller = <&mdss_dsi0>;
		qcom,mdss-dsi-panel-type = "dsi_video_mode";
		qcom,mdss-dsi-panel-destination = "display_1";
		qcom,mdss-dsi-panel-framerate = <60>;
		qcom,mdss-dsi-virtual-channel-id = <0>;
		qcom,mdss-dsi-stream = <0>;
		qcom,mdss-dsi-panel-width = <720>;
		qcom,mdss-dsi-panel-height = <1280>;
		qcom,mdss-dsi-h-front-porch = <140>;
		qcom,mdss-dsi-h-back-porch = <164>;
		qcom,mdss-dsi-h-pulse-width = <8>;
		qcom,mdss-dsi-h-sync-skew = <0>;
		qcom,mdss-dsi-v-back-porch = <1>;
		qcom,mdss-dsi-v-front-porch = <6>;
		qcom,mdss-dsi-v-pulse-width = <1>;
		qcom,mdss-dsi-h-left-border = <0>;
		qcom,mdss-dsi-h-right-border = <0>;
		qcom,mdss-dsi-v-top-border = <0>;
		qcom,mdss-dsi-v-bottom-border = <0>;
		qcom,mdss-dsi-bpp = <24>;
		qcom,mdss-dsi-color-order = <0>;
		qcom,mdss-dsi-underflow-color = <0xff>;
		qcom,mdss-dsi-border-color = <0>;
		qcom,mdss-dsi-on-command = [29 01 00 00 00 00 02 FF EE
						29 01 00 00 00 00 02 26 08
						29 01 00 00 00 00 02 26 00
						29 01 00 00 10 00 02 FF 00
						29 01 00 00 00 00 02 FF 01
						29 01 00 00 00 00 02 FB 01
						29 01 00 00 00 00 02 00 4A
						29 01 00 00 00 00 02 01 33
						29 01 00 00 00 00 02 02 53
						29 01 00 00 00 00 02 03 55
						29 01 00 00 00 00 02 04 55
						29 01 00 00 00 00 02 05 33
						29 01 00 00 00 00 02 06 22
						29 01 00 00 00 00 02 08 56
						29 01 00 00 00 00 02 09 8F
						29 01 00 00 00 00 02 0B CF
						29 01 00 00 00 00 02 0C CF
						29 01 00 00 00 00 02 0D 2F
						29 01 00 00 00 00 02 0E 29
						29 01 00 00 00 00 02 36 73
						29 01 00 00 00 00 02 0F 0A
						29 01 00 00 00 00 02 FF EE
						29 01 00 00 78 00 02 FB 01
						29 01 00 00 00 00 02 12 50
						29 01 00 00 00 00 02 13 02
						29 01 00 00 00 00 02 6A 60
						29 01 00 00 00 00 02 FF 05
						29 01 00 00 00 00 02 FB 01
						29 01 00 00 00 00 02 01 00
						29 01 00 00 00 00 02 02 82
						29 01 00 00 00 00 02 03 82
						29 01 00 00 00 00 02 04 82
						29 01 00 00 00 00 02 06 33
						29 01 00 00 00 00 02 07 01
						29 01 00 00 00 00 02 08 00
						29 01 00 00 00 00 02 09 46
						29 01 00 00 00 00 02 0A 46
						29 01 00 00 00 00 02 0D 0B
						29 01 00 00 00 00 02 0E 1D
						29 01 00 00 00 00 02 0F 08
						29 01 00 00 00 00 02 10 53
						29 01 00 00 00 00 02 11 00
						29 01 00 00 00 00 02 12 00
						29 01 00 00 00 00 02 14 01
						29 01 00 00 00 00 02 15 00
						29 01 00 00 00 00 02 16 05
						29 01 00 00 00 00 02 17 00
						29 01 00 00 00 00 02 19 7F
						29 01 00 00 00 00 02 1A FF
						29 01 00 00 00 00 02 1B 0F
						29 01 00 00 00 00 02 1C 00
						29 01 00 00 00 00 02 1D 00
						29 01 00 00 00 00 02 1E 00
						29 01 00 00 00 00 02 1F 07
						29 01 00 00 00 00 02 20 00
						29 01 00 00 00 00 02 21 00
						29 01 00 00 00 00 02 22 55
						29 01 00 00 00 00 02 23 4D
						29 01 00 00 00 00 02 2D 02
						29 01 00 00 00 00 02 83 01
						29 01 00 00 00 00 02 9E 58
						29 01 00 00 00 00 02 9F 68
						29 01 00 00 00 00 02 A0 01
						29 01 00 00 00 00 02 A2 10
						29 01 00 00 00 00 02 BB 0A
						29 01 00 00 00 00 02 BC 0A
						29 01 00 00 00 00 02 28 01
						29 01 00 00 00 00 02 2F 02
						29 01 00 00 00 00 02 32 08
						29 01 00 00 00 00 02 33 B8
						29 01 00 00 00 00 02 36 01
						29 01 00 00 00 00 02 37 00
						29 01 00 00 00 00 02 43 00
						29 01 00 00 00 00 02 4B 21
						29 01 00 00 00 00 02 4C 03
						29 01 00 00 00 00 02 50 21
						29 01 00 00 00 00 02 51 03
						29 01 00 00 00 00 02 58 21
						29 01 00 00 00 00 02 59 03
						29 01 00 00 00 00 02 5D 21
						29 01 00 00 00 00 02 5E 03
						29 01 00 00 00 00 02 6C 00
						29 01 00 00 00 00 02 6D 00
						29 01 00 00 00 00 02 FF 00
						29 01 00 00 00 00 02 FB 01
						29 01 00 00 00 00 02 BA 03
						29 01 00 00 00 00 02 C2 0B
						29 01 00 00 00 00 02 FF 01
						29 01 00 00 00 00 02 FB 01
						29 01 00 00 00 00 02 75 00
						29 01 00 00 00 00 02 76 98
						29 01 00 00 00 00 02 77 00
						29 01 00 00 00 00 02 78 AF
						29 01 00 00 00 00 02 79 00
						29 01 00 00 00 00 02 7A D1
						29 01 00 00 00 00 02 7B 00
						29 01 00 00 00 00 02 7C E9
						29 01 00 00 00 00 02 7D 00
						29 01 00 00 00 00 02 7E FE
						29 01 00 00 00 00 02 7F 01
						29 01 00 00 00 00 02 80 10
						29 01 00 00 00 00 02 81 01
						29 01 00 00 00 00 02 82 20
						29 01 00 00 00 00 02 83 01
						29 01 00 00 00 00 02 84 2E
						29 01 00 00 00 00 02 85 01
						29 01 00 00 00 00 02 86 3B
						29 01 00 00 00 00 02 87 01
						29 01 00 00 00 00 02 88 65
						29 01 00 00 00 00 02 89 01
						29 01 00 00 00 00 02 8A 88
						29 01 00 00 00 00 02 8B 01
						29 01 00 00 00 00 02 8C BD
						29 01 00 00 00 00 02 8D 01
						29 01 00 00 00 00 02 8E E7
						29 01 00 00 00 00 02 8F 02
						29 01 00 00 00 00 02 90 27
						29 01 00 00 00 00 02 91 02
						29 01 00 00 00 00 02 92 59
						29 01 00 00 00 00 02 93 02
						29 01 00 00 00 00 02 94 5B
						29 01 00 00 00 00 02 95 02
						29 01 00 00 00 00 02 96 87
						29 01 00 00 00 00 02 97 02
						29 01 00 00 00 00 02 98 B6
						29 01 00 00 00 00 02 99 02
						29 01 00 00 00 00 02 9A D5
						29 01 00 00 00 00 02 9B 02
						29 01 00 00 00 00 02 9C FD
						29 01 00 00 00 00 02 9D 03
						29 01 00 00 00 00 02 9E 19
						29 01 00 00 00 00 02 9F 03
						29 01 00 00 00 00 02 A0 40
						29 01 00 00 00 00 02 A2 03
						29 01 00 00 00 00 02 A3 4C
						29 01 00 00 00 00 02 A4 03
						29 01 00 00 00 00 02 A5 59
						29 01 00 00 00 00 02 A6 03
						29 01 00 00 00 00 02 A7 67
						29 01 00 00 00 00 02 A9 03
						29 01 00 00 00 00 02 AA 78
						29 01 00 00 00 00 02 AB 03
						29 01 00 00 00 00 02 AC 8A
						29 01 00 00 00 00 02 AD 03
						29 01 00 00 00 00 02 AE A8
						29 01 00 00 00 00 02 AF 03
						29 01 00 00 00 00 02 B0 B8
						29 01 00 00 00 00 02 B1 03
						29 01 00 00 00 00 02 B2 BE
						29 01 00 00 00 00 02 B3 00
						29 01 00 00 00 00 02 B4 98
						29 01 00 00 00 00 02 B5 00
						29 01 00 00 00 00 02 B6 AF
						29 01 00 00 00 00 02 B7 00
						29 01 00 00 00 00 02 B8 D1
						29 01 00 00 00 00 02 B9 00
						29 01 00 00 00 00 02 BA E9
						29 01 00 00 00 00 02 BB 00
						29 01 00 00 00 00 02 BC FE
						29 01 00 00 00 00 02 BD 01
						29 01 00 00 00 00 02 BE 10
						29 01 00 00 00 00 02 BF 01
						29 01 00 00 00 00 02 C0 20
						29 01 00 00 00 00 02 C1 01
						29 01 00 00 00 00 02 C2 2E
						29 01 00 00 00 00 02 C3 01
						29 01 00 00 00 00 02 C4 3B
						29 01 00 00 00 00 02 C5 01
						29 01 00 00 00 00 02 C6 65
						29 01 00 00 00 00 02 C7 01
						29 01 00 00 00 00 02 C8 88
						29 01 00 00 00 00 02 C9 01
						29 01 00 00 00 00 02 CA BD
						29 01 00 00 00 00 02 CB 01
						29 01 00 00 00 00 02 CC E7
						29 01 00 00 00 00 02 CD 02
						29 01 00 00 00 00 02 CE 27
						29 01 00 00 00 00 02 CF 02
						29 01 00 00 00 00 02 D0 59
						29 01 00 00 00 00 02 D1 02
						29 01 00 00 00 00 02 D2 5B
						29 01 00 00 00 00 02 D3 02
						29 01 00 00 00 00 02 D4 87
						29 01 00 00 00 00 02 D5 02
						29 01 00 00 00 00 02 D6 B6
						29 01 00 00 00 00 02 D7 02
						29 01 00 00 00 00 02 D8 D5
						29 01 00 00 00 00 02 D9 02
						29 01 00 00 00 00 02 DA FD
						29 01 00 00 00 00 02 DB 03
						29 01 00 00 00 00 02 DC 19
						29 01 00 00 00 00 02 DD 03
						29 01 00 00 00 00 02 DE 40
						29 01 00 00 00 00 02 DF 03
						29 01 00 00 00 00 02 E0 4C
						29 01 00 00 00 00 02 E1 03
						29 01 00 00 00 00 02 E2 59
						29 01 00 00 00 00 02 E3 03
						29 01 00 00 00 00 02 E4 67
						29 01 00 00 00 00 02 E5 03
						29 01 00 00 00 00 02 E6 78
						29 01 00 00 00 00 02 E7 03
						29 01 00 00 00 00 02 E8 8A
						29 01 00 00 00 00 02 E9 03
						29 01 00 00 00 00 02 EA A8
						29 01 00 00 00 00 02 EB 03
						29 01 00 00 00 00 02 EC B8
						29 01 00 00 00 00 02 ED 03
						29 01 00 00 00 00 02 EE BE
						29 01 00 00 00 00 02 EF 00
						29 01 00 00 00 00 02 F0 98
						29 01 00 00 00 00 02 F1 00
						29 01 00 00 00 00 02 F2 AF
						29 01 00 00 00 00 02 F3 00
						29 01 00 00 00 00 02 F4 D1
						29 01 00 00 00 00 02 F5 00
						29 01 00 00 00 00 02 F6 E9
						29 01 00 00 00 00 02 F7 00
						29 01 00 00 00 00 02 F8 FE
						29 01 00 00 00 00 02 F9 01
						29 01 00 00 00 00 02 FA 10
						29 01 00 00 00 00 02 FF 02
						29 01 00 00 00 00 02 FB 01
						29 01 00 00 00 00 02 00 01
						29 01 00 00 00 00 02 01 20
						29 01 00 00 00 00 02 02 01
						29 01 00 00 00 00 02 03 2E
						29 01 00 00 00 00 02 04 01
						29 01 00 00 00 00 02 05 3B
						29 01 00 00 00 00 02 06 01
						29 01 00 00 00 00 02 07 65
						29 01 00 00 00 00 02 08 01
						29 01 00 00 00 00 02 09 88
						29 01 00 00 00 00 02 0A 01
						29 01 00 00 00 00 02 0B BD
						29 01 00 00 00 00 02 0C 01
						29 01 00 00 00 00 02 0D E7
						29 01 00 00 00 00 02 0E 02
						29 01 00 00 00 00 02 0F 27
						29 01 00 00 00 00 02 10 02
						29 01 00 00 00 00 02 11 59
						29 01 00 00 00 00 02 12 02
						29 01 00 00 00 00 02 13 5B
						29 01 00 00 00 00 02 14 02
						29 01 00 00 00 00 02 15 87
						29 01 00 00 00 00 02 16 02
						29 01 00 00 00 00 02 17 B6
						29 01 00 00 00 00 02 18 02
						29 01 00 00 00 00 02 19 D5
						29 01 00 00 00 00 02 1A 02
						29 01 00 00 00 00 02 1B FD
						29 01 00 00 00 00 02 1C 03
						29 01 00 00 00 00 02 1D 19
						29 01 00 00 00 00 02 1E 03
						29 01 00 00 00 00 02 1F 40
						29 01 00 00 00 00 02 20 03
						29 01 00 00 00 00 02 21 4C
						29 01 00 00 00 00 02 22 03
						29 01 00 00 00 00 02 23 59
						29 01 00 00 00 00 02 24 03
						29 01 00 00 00 00 02 25 67
						29 01 00 00 00 00 02 26 03
						29 01 00 00 00 00 02 27 78
						29 01 00 00 00 00 02 28 03
						29 01 00 00 00 00 02 29 8A
						29 01 00 00 00 00 02 2A 03
						29 01 00 00 00 00 02 2B A8
						29 01 00 00 00 00 02 2D 03
						29 01 00 00 00 00 02 2F B8
						29 01 00 00 00 00 02 30 03
						29 01 00 00 00 00 02 31 BE
						29 01 00 00 00 00 02 32 00
						29 01 00 00 00 00 02 33 98
						29 01 00 00 00 00 02 34 00
						29 01 00 00 00 00 02 35 AF
						29 01 00 00 00 00 02 36 00
						29 01 00 00 00 00 02 37 D1
						29 01 00 00 00 00 02 38 00
						29 01 00 00 00 00 02 39 E9
						29 01 00 00 00 00 02 3A 00
						29 01 00 00 00 00 02 3B FE
						29 01 00 00 00 00 02 3D 01
						29 01 00 00 00 00 02 3F 10
						29 01 00 00 00 00 02 40 01
						29 01 00 00 00 00 02 41 20
						29 01 00 00 00 00 02 42 01
						29 01 00 00 00 00 02 43 2E
						29 01 00 00 00 00 02 44 01
						29 01 00 00 00 00 02 45 3B
						29 01 00 00 00 00 02 46 01
						29 01 00 00 00 00 02 47 65
						29 01 00 00 00 00 02 48 01
						29 01 00 00 00 00 02 49 88
						29 01 00 00 00 00 02 4A 01
						29 01 00 00 00 00 02 4B BD
						29 01 00 00 00 00 02 4C 01
						29 01 00 00 00 00 02 4D E7
						29 01 00 00 00 00 02 4E 02
						29 01 00 00 00 00 02 4F 27
						29 01 00 00 00 00 02 50 02
						29 01 00 00 00 00 02 51 59
						29 01 00 00 00 00 02 52 02
						29 01 00 00 00 00 02 53 5B
						29 01 00 00 00 00 02 54 02
						29 01 00 00 00 00 02 55 87
						29 01 00 00 00 00 02 56 02
						29 01 00 00 00 00 02 58 B6
						29 01 00 00 00 00 02 59 02
						29 01 00 00 00 00 02 5A D5
						29 01 00 00 00 00 02 5B 02
						29 01 00 00 00 00 02 5C FD
						29 01 00 00 00 00 02 5D 03
						29 01 00 00 00 00 02 5E 19
						29 01 00 00 00 00 02 5F 03
						29 01 00 00 00 00 02 60 40
						29 01 00 00 00 00 02 61 03
						29 01 00 00 00 00 02 62 4C
						29 01 00 00 00 00 02 63 03
						29 01 00 00 00 00 02 64 59
						29 01 00 00 00 00 02 65 03
						29 01 00 00 00 00 02 66 67
						29 01 00 00 00 00 02 67 03
						29 01 00 00 00 00 02 68 78
						29 01 00 00 00 00 02 69 03
						29 01 00 00 00 00 02 6A 8A
						29 01 00 00 00 00 02 6B 03
						29 01 00 00 00 00 02 6C A8
						29 01 00 00 00 00 02 6D 03
						29 01 00 00 00 00 02 6E B8
						29 01 00 00 00 00 02 6F 03
						29 01 00 00 00 00 02 70 BE
						29 01 00 00 00 00 02 71 00
						29 01 00 00 00 00 02 72 98
						29 01 00 00 00 00 02 73 00
						29 01 00 00 00 00 02 74 AF
						29 01 00 00 00 00 02 75 00
						29 01 00 00 00 00 02 76 D1
						29 01 00 00 00 00 02 77 00
						29 01 00 00 00 00 02 78 E9
						29 01 00 00 00 00 02 79 00
						29 01 00 00 00 00 02 7A FE
						29 01 00 00 00 00 02 7B 01
						29 01 00 00 00 00 02 7C 10
						29 01 00 00 00 00 02 7D 01
						29 01 00 00 00 00 02 7E 20
						29 01 00 00 00 00 02 7F 01
						29 01 00 00 00 00 02 80 2E
						29 01 00 00 00 00 02 81 01
						29 01 00 00 00 00 02 82 3B
						29 01 00 00 00 00 02 83 01
						29 01 00 00 00 00 02 84 65
						29 01 00 00 00 00 02 85 01
						29 01 00 00 00 00 02 86 88
						29 01 00 00 00 00 02 87 01
						29 01 00 00 00 00 02 88 BD
						29 01 00 00 00 00 02 89 01
						29 01 00 00 00 00 02 8A E7
						29 01 00 00 00 00 02 8B 02
						29 01 00 00 00 00 02 8C 27
						29 01 00 00 00 00 02 8D 02
						29 01 00 00 00 00 02 8E 59
						29 01 00 00 00 00 02 8F 02
						29 01 00 00 00 00 02 90 5B
						29 01 00 00 00 00 02 91 02
						29 01 00 00 00 00 02 92 87
						29 01 00 00 00 00 02 93 02
						29 01 00 00 00 00 02 94 B6
						29 01 00 00 00 00 02 95 02
						29 01 00 00 00 00 02 96 D5
						29 01 00 00 00 00 02 97 02
						29 01 00 00 00 00 02 98 FD
						29 01 00 00 00 00 02 99 03
						29 01 00 00 00 00 02 9A 19
						29 01 00 00 00 00 02 9B 03
						29 01 00 00 00 00 02 9C 40
						29 01 00 00 00 00 02 9D 03
						29 01 00 00 00 00 02 9E 4C
						29 01 00 00 00 00 02 9F 03
						29 01 00 00 00 00 02 A0 59
						29 01 00 00 00 00 02 A2 03
						29 01 00 00 00 00 02 A3 67
						29 01 00 00 00 00 02 A4 03
						29 01 00 00 00 00 02 A5 78
						29 01 00 00 00 00 02 A6 03
						29 01 00 00 00 00 02 A7 8A
						29 01 00 00 00 00 02 A9 03
						29 01 00 00 00 00 02 AA A8
						29 01 00 00 00 00 02 AB 03
						29 01 00 00 00 00 02 AC B8
						29 01 00 00 00 00 02 AD 03
						29 01 00 00 00 00 02 AE BE
						29 01 00 00 00 00 02 AF 00
						29 01 00 00 00 00 02 B0 98
						29 01 00 00 00 00 02 B1 00
						29 01 00 00 00 00 02 B2 AF
						29 01 00 00 00 00 02 B3 00
						29 01 00 00 00 00 02 B4 D1
						29 01 00 00 00 00 02 B5 00
						29 01 00 00 00 00 02 B6 E9
						29 01 00 00 00 00 02 B7 00
						29 01 00 00 00 00 02 B8 FE
						29 01 00 00 00 00 02 B9 01
						29 01 00 00 00 00 02 BA 10
						29 01 00 00 00 00 02 BB 01
						29 01 00 00 00 00 02 BC 20
						29 01 00 00 00 00 02 BD 01
						29 01 00 00 00 00 02 BE 2E
						29 01 00 00 00 00 02 BF 01
						29 01 00 00 00 00 02 C0 3B
						29 01 00 00 00 00 02 C1 01
						29 01 00 00 00 00 02 C2 65
						29 01 00 00 00 00 02 C3 01
						29 01 00 00 00 00 02 C4 88
						29 01 00 00 00 00 02 C5 01
						29 01 00 00 00 00 02 C6 BD
						29 01 00 00 00 00 02 C7 01
						29 01 00 00 00 00 02 C8 E7
						29 01 00 00 00 00 02 C9 02
						29 01 00 00 00 00 02 CA 27
						29 01 00 00 00 00 02 CB 02
						29 01 00 00 00 00 02 CC 59
						29 01 00 00 00 00 02 CD 02
						29 01 00 00 00 00 02 CE 5B
						29 01 00 00 00 00 02 CF 02
						29 01 00 00 00 00 02 D0 87
						29 01 00 00 00 00 02 D1 02
						29 01 00 00 00 00 02 D2 B6
						29 01 00 00 00 00 02 D3 02
						29 01 00 00 00 00 02 D4 D5
						29 01 00 00 00 00 02 D5 02
						29 01 00 00 00 00 02 D6 FD
						29 01 00 00 00 00 02 D7 03
						29 01 00 00 00 00 02 D8 19
						29 01 00 00 00 00 02 D9 03
						29 01 00 00 00 00 02 DA 40
						29 01 00 00 00 00 02 DB 03
						29 01 00 00 00 00 02 DC 4C
						29 01 00 00 00 00 02 DD 03
						29 01 00 00 00 00 02 DE 59
						29 01 00 00 00 00 02 DF 03
						29 01 00 00 00 00 02 E0 67
						29 01 00 00 00 00 02 E1 03
						29 01 00 00 00 00 02 E2 78
						29 01 00 00 00 00 02 E3 03
						29 01 00 00 00 00 02 E4 8A
						29 01 00 00 00 00 02 E5 03
						29 01 00 00 00 00 02 E6 A8
						29 01 00 00 00 00 02 E7 03
						29 01 00 00 00 00 02 E8 B8
						29 01 00 00 00 00 02 E9 03
						29 01 00 00 00 00 02 EA BE
						29 01 00 00 00 00 02 FF 00
						29 01 00 00 64 00 02 11 00
						29 01 00 00 00 00 02 FF EE
						29 01 00 00 00 00 02 12 50
						29 01 00 00 00 00 02 13 02
						29 01 00 00 00 00 02 6A 60
						29 01 00 00 00 00 02 FF 00
						29 01 00 00 78 00 02 29 00
						29 01 00 00 78 00 02 53 2C];
		qcom,mdss-dsi-off-command = [05 01 00 00 32 00 02 28 00
					05 01 00 00 78 00 02 10 00];
		qcom,mdss-dsi-on-command-state = "dsi_lp_mode";
		qcom,mdss-dsi-off-command-state = "dsi_hs_mode";
		qcom,mdss-dsi-h-sync-pulse = <1>;
		qcom,mdss-dsi-traffic-mode = <2>;
		qcom,mdss-dsi-lane-map = <0>;
		qcom,mdss-dsi-bllp-eof-power-mode;
		qcom,mdss-dsi-bllp-power-mode;
		qcom,mdss-dsi-lane-0-state;
		qcom,mdss-dsi-lane-1-state;
		qcom,mdss-dsi-lane-2-state;
		qcom,mdss-dsi-lane-3-state;
		qcom,mdss-dsi-panel-timings = [7d 25 1d 00 37 33 22 27 1e 03 04 00];
		qcom,mdss-dsi-t-clk-post = <0x20>;
		qcom,mdss-dsi-t-clk-pre = <0x2c>;
		qcom,mdss-dsi-bl-min-level = <1>;
		qcom,mdss-dsi-bl-max-level = <4095>;
		qcom,mdss-dsi-dma-trigger = <4>;
		qcom,mdss-dsi-mdp-trigger = <0>;
		qcom,mdss-dsi-bl-pmic-control-type = "bl_ctrl_wled";
		qcom,mdss-dsi-reset-sequence = <1 20>, <0 20>, <1 20>;
		qcom,mdss-pan-physical-width-dimension = <59>;
		qcom,mdss-pan-physical-height-dimension = <104>;

	};
};
