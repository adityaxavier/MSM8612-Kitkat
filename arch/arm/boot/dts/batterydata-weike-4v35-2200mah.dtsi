/* Copyright (c) 2013, The Linux Foundation. All rights reserved.
 *
 * This program is free software; you can redistribute it and/or modify
 * it under the terms of the GNU General Public License version 2 and
 * only version 2 as published by the Free Software Foundation.
 *
 * This program is distributed in the hope that it will be useful,
 * but WITHOUT ANY WARRANTY; without even the implied warranty of
 * MERCHANTABILITY or FITNESS FOR A PARTICULAR PURPOSE.  See the
 * GNU General Public License for more details.
 */

qcom,qrd-4v35-2000mAh-data {
	qcom,fcc-mah = <2200>;
	qcom,default-rbatt-mohm = <182>;
	qcom,rbatt-capacitive-mohm = <0>;
	qcom,flat-ocv-threshold-uv = <3800000>;
	qcom,max-voltage-uv = <4350000>;
	qcom,v-cutoff-uv = <3400000>;
	qcom,chg-term-ua = <150000>;
	qcom,batt-id-kohm = <200>;

	qcom,rbatt-sf-lut {
		qcom,lut-col-legend = <(-20) 0 25 40 60>;
		qcom,lut-row-legend = <100 95 90 85 80>,
				<75 70 65 60 55>,
				<50 45 40 35 30>,
				<25 20 16 13 11>,
				<10 9 8 7 6>,
				<5 4 3 2 1>;
		qcom,lut-data = <1115 253 100 84 79>,
				<1114 253 100 84 79>,
				<1067 258 103 86 80>,
				<1026 258 106 87 81>,
				<1006 253 110 90 83>,
				<959 253 117 93 85>,
				<971 245 123 98 88>,
				<981 248 125 104 92>,
				<999 250 112 102 93>,
				<1024 254 103 87 82>,
				<1059 259 102 86 81>,
				<1103 265 104 88 83>,
				<1152 270 107 91 85>,
				<1208 278 109 92 88>,
				<1273 292 111 91 86>,
				<1364 324 113 90 82>,
				<1571 379 115 90 82>,
				<1858 441 116 92 83>,
				<1956 462 110 88 81>,
				<2143 462 110 89 82>,
				<2397 493 113 90 84>,
				<2709 528 117 92 85>,
				<3113 574 123 95 87>,
				<3686 636 129 98 88>,
				<4456 727 136 100 87>,
				<5634 857 139 96 86>,
				<7462 1056 140 98 86>,
				<10717 1425 157 103 89>,
				<17185 2179 198 111 92>,
				<34511 4131 345 146 103>;
	};

	qcom,fcc-temp-lut {
		qcom,lut-col-legend = <(-20) 0 25 40 60>;
		qcom,lut-data = <2262 2260 2260 2259 2249>;
	};

	qcom,pc-temp-ocv-lut {
		qcom,lut-col-legend = <(-20) 0 25 40 60>;
		qcom,lut-row-legend = <100 95 90 85 80>,
				<75 70 65 60 55>,
				<50 45 40 35 30>,
				<25 20 16 13 11>,
				<10 9 8 7 6>,
				<5 4 3 2 1>,
				<0>;
		qcom,lut-data = <4322 4322 4317 4312 4303>,
				<4221 4242 4245 4243 4238>,
				<4149 4182 4186 4185 4181>,
				<4084 4123 4131 4130 4126>,
				<4034 4066 4079 4077 4074>,
				<3957 4007 4030 4029 4026>,
				<3914 3949 3984 3985 3982>,
				<3875 3915 3941 3944 3942>,
				<3839 3879 3893 3900 3901>,
				<3811 3848 3854 3855 3855>,
				<3789 3820 3827 3828 3827>,
				<3770 3795 3806 3806 3805>,
				<3752 3773 3789 3789 3788>,
				<3736 3755 3775 3774 3773>,
				<3718 3738 3763 3760 3754>,
				<3699 3725 3750 3744 3731>,
				<3677 3714 3731 3725 3711>,
				<3656 3706 3708 3702 3689>,
				<3635 3699 3688 3680 3669>,
				<3619 3690 3682 3676 3664>,
				<3609 3685 3680 3674 3663>,
				<3597 3679 3678 3672 3662>,
				<3582 3672 3676 3670 3660>,
				<3566 3661 3672 3667 3656>,
				<3548 3646 3664 3659 3644>,
				<3523 3623 3641 3632 3615>,
				<3494 3588 3596 3584 3568>,
				<3454 3538 3533 3522 3507>,
				<3393 3464 3450 3438 3425>,
				<3282 3340 3323 3306 3301>,
				<3000 3000 3000 3000 3000>;
	};
};
